## components/filesystem/Kconfig
```kconfig
menu "ESPNetLink filesystem"

    config FILESYSTEM_PARTITION_LABEL
        string "Internal data FS partition label"
        default "storage"
        help
            Label of the LittleFS data partition the filesystem component
            mounts at /data. Must exist in the partition table.

endmenu
```

## components/i2c_bus/Kconfig
```kconfig
menu "ESPNetLink i2c_bus"

config WICAN_I2C_SDA_GPIO
    int "I2C SDA GPIO"
    default 48
    help
        SDA pin of the shared peripheral I2C bus (ESPNetLink ESP32-S3:
        GPIO48 — the ICM-42670 IMU pins from hw_config.h; WiCAN Pro
        uses GPIO5). Per-hardware-revision; override in the board's
        sdkconfig.

config WICAN_I2C_SCL_GPIO
    int "I2C SCL GPIO"
    default 47
    help
        SCL pin of the shared peripheral I2C bus (ESPNetLink ESP32-S3:
        GPIO47; WiCAN Pro uses GPIO6).

endmenu
```

## components/log_manager/Kconfig
```kconfig
menu "WiCAN log_manager"

    config LOG_MANAGER_LINE_MAX
        int "Maximum log line length (bytes)"
        default 256
        range 128 1024

    config LOG_MANAGER_QUEUE_DEPTH
        int "Message queue depth (lines)"
        default 64
        range 8 512
        help
            Producer-side buffer between ESP_LOGx callers and the log task.
            Full queue drops the OLDEST line (never blocks a producer).

    config LOG_MANAGER_RING_SIZE
        int "PSRAM crash ring size (bytes)"
        default 16384
        range 1024 262144
        help
            PSRAM .noinit ring holding the most recent log output across
            warm resets (readable after a crash, zero flash wear).

endmenu
```

## components/mdns_manager/Kconfig
```kconfig
menu "ESPNetLink mdns_manager"

config WICAN_HW_VERSION
    string "Hardware version string"
    default "ESPNetLink"
    help
        Advertised in the mDNS TXT record `hardware` (and available to
        other surfaces). This is the ESPNetLink firmware; the WICAN_
        symbol name is kept because cross-component consumers (api_http,
        ha_webhooks, dev_status_manager) share it across MeatPi
        products. Per-hardware-revision; override in the board's
        sdkconfig.

config WICAN_DEVICE_TYPE
    string "Device type slug"
    default "espnetlink"
    help
        The MeatPi HA-integration profile slug (device-contract v2):
        lowercase, stable per product ("wican_pro", "wican_usb",
        "wican", "espnetlink", ...). Advertised in the mDNS TXT record
        `device_type` and returned by GET /api/info. This is the
        ESPNetLink firmware; override in the board's sdkconfig.

config WICAN_MODEL_NAME
    string "Product model name"
    default "ESPNetLink"
    help
        Human-readable model (the ESPNetLink product name). Returned by
        GET /api/info; shown in the HA device registry.

endmenu
```
